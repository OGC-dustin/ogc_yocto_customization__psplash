## conf/layer.conf
```bitbake
# We have a conf and classes directory, add to BBPATH
BBPATH .= ":${LAYERDIR}"

# We have recipes-* directories, add to BBFILES
BBFILES += "${LAYERDIR}/recipes-*/*/*.bb \
            ${LAYERDIR}/recipes-*/*/*.bbappend"

BBFILE_COLLECTIONS += "ogc_yocto_customization__psplash"
BBFILE_PATTERN_ogc_yocto_customization__psplash = "^${LAYERDIR}/"
BBFILE_PRIORITY_ogc_yocto_customization__psplash = "6"

LAYERDEPENDS_ogc_yocto_customization__psplash = "core"
LAYERSERIES_COMPAT_ogc_yocto_customization__psplash = "kirkstone"
```
